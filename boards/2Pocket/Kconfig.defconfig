## boards/shields/2Pocket/Kconfig.defconfig
```kconfig
endif

if SHIELD_2POCKET_LEFT

config ZMK_KEYBOARD_NAME
    default "2pocket"

config ZMK_SPLIT_ROLE_CENTRAL
    default y

endif

if SHIELD_2POCKET_LEFT || SHIELD_2POCKET_RIGHT

config ZMK_SPLIT
    default y

endif
```

## boards/shields/2Pocket/Kconfig.shield
```kconfig
config SHIELD_2POCKET_LEFT
    def_bool $(shields_list_contains,2Pocket_left)
config SHIELD_2POCKET_RIGHT
    def_bool $(shields_list_contains,2Pocket_right)
```
